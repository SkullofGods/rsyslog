## buildroot/package/rsyslog-wbos-config/Config.in
```kconfig
config BR2_PACKAGE_RSYSLOG_WBOS_CONFIG
	bool "rsyslog-wbos-config"
	select BR2_PACKAGE_RSYSLOG
	help
	  WBOS rsyslog configuration overlay.

	  Installs an rsyslog main config and an /etc/rsyslog.d drop-in that
	  receive the RFC 5424 structured log stream from the WBOS daemons
	  (asic_manager, config_manager, route_manager, route_server,
	  flow_manager) on /dev/log and route it, RFC 5424 preserved, into
	  per-service files under /var/log/wbos/.

	  Requires the imuxsock, pmrfc5424 and mmpstrucdata rsyslog modules.

if BR2_PACKAGE_RSYSLOG_WBOS_CONFIG

config BR2_PACKAGE_RSYSLOG_WBOS_CONFIG_VERSION
	string "rsyslog-wbos-config git ref"
	default "myc_custom"

endif
```

## buildroot/package/rsyslog/Config.in
```kconfig
config BR2_PACKAGE_RSYSLOG
	bool "rsyslog"
	depends on BR2_USE_MMU # fork()
	depends on BR2_TOOLCHAIN_HAS_THREADS
	depends on BR2_USE_WCHAR
	select BR2_PACKAGE_LIBESTR
	select BR2_PACKAGE_LIBFASTJSON
	select BR2_PACKAGE_LIBLOGGING
	select BR2_PACKAGE_ZLIB
	help
	  Rsyslog is an enhanced multi-threaded syslogd. Built from the WBOS
	  fork with the WBOS RFC 5424 receiver config installed, so the
	  structured log stream from the WBOS daemons (asic_manager,
	  config_manager, route_manager, route_server, flow_manager) is
	  received on /dev/log and routed into /var/log/wbos/. Uses only stock
	  modules (imuxsock, imklog, the built-in rfc5424 parser).

	  https://www.rsyslog.com/

if BR2_PACKAGE_RSYSLOG

config BR2_PACKAGE_RSYSLOG_EXTRA_PLUGINS
	bool "extra plugins"
	help
	  Build and install the full set of optional input/output/parser/
	  modify plugins (imfile, impstats, omprog, mmjsonparse, mmpstrucdata,
	  ...) and the dependency-gated ones (gnutls, hiredis, mysql, ...). The
	  WBOS log pipeline does not require any of these.

endif

comment "rsyslog needs a toolchain w/ threads, wchar"
	depends on BR2_USE_MMU
	depends on !BR2_TOOLCHAIN_HAS_THREADS || !BR2_USE_WCHAR
```
